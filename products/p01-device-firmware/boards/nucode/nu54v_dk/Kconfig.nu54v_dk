## products/p01-device-firmware/boards/nucode/nu54v_dk/Kconfig.nu54v_dk
```kconfig
config BOARD_NU54V_DK
	select SOC_NRF54L15_CPUAPP if BOARD_NU54V_DK_NRF54L15_CPUAPP || BOARD_NU54V_DK_NRF54L15_CPUAPP_NS
	select USE_DT_CODE_PARTITION if BOARD_NU54V_DK_NRF54L15_CPUAPP_NS
```
