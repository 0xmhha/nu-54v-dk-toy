## CMakeLists.txt
```
# P01 payment signer firmware (DF-20260925-02, [D05][N25]).
cmake_minimum_required(VERSION 3.20.0)

# Board package vendored under ../boards (see boards/nucode/nu54v_dk/VENDORED.md).
list(APPEND BOARD_ROOT ${CMAKE_CURRENT_LIST_DIR}/..)

find_package(Zephyr REQUIRED HINTS $ENV{ZEPHYR_BASE})
project(nu54_signer)

# Generated protocol constants shared with the kiosk, operator tool and contracts.
target_include_directories(app PRIVATE ${CMAKE_CURRENT_LIST_DIR}/../../../packages/protocol/c/include)

# Board-independent core, also built and tested on the host (see ../test).
target_include_directories(app PRIVATE ${CMAKE_CURRENT_LIST_DIR}/../core/include)

target_sources(app PRIVATE
  src/main.c
  src/board_io.c
  ${CMAKE_CURRENT_LIST_DIR}/../core/src/nu54_frame.c
  ${CMAKE_CURRENT_LIST_DIR}/../core/src/nu54_button.c
  ${CMAKE_CURRENT_LIST_DIR}/../core/src/nu54_pin_entry.c
  src/device_key.c
  src/device_setup.c
  src/pay_link.c
  src/ble_links.c
  src/status_led.c
  ${CMAKE_CURRENT_LIST_DIR}/../core/src/nu54_keccak.c
  ${CMAKE_CURRENT_LIST_DIR}/../core/src/nu54_eip712.c
  ${CMAKE_CURRENT_LIST_DIR}/../core/src/nu54_sig.c
  ${CMAKE_CURRENT_LIST_DIR}/../core/src/nu54_secure.c
  ${CMAKE_CURRENT_LIST_DIR}/../core/src/nu54_cbor.c
  ${CMAKE_CURRENT_LIST_DIR}/../core/src/nu54_session.c
  ${CMAKE_CURRENT_LIST_DIR}/../core/src/nu54_session_util.c
  ${CMAKE_CURRENT_LIST_DIR}/../core/src/nu54_session_channel.c
  ${CMAKE_CURRENT_LIST_DIR}/../core/src/nu54_session_setup.c
  ${CMAKE_CURRENT_LIST_DIR}/../core/src/nu54_session_pay.c
  ${CMAKE_CURRENT_LIST_DIR}/../core/src/nu54_session_limit.c
  ${CMAKE_CURRENT_LIST_DIR}/../core/src/nu54_links.c
  ${CMAKE_CURRENT_LIST_DIR}/../third_party/keccak/Keccak-readable-and-compact.c
)

# libsecp256k1 (recovery for operator and merchant signatures, low-s and v): same settings as
# the host tests in ../test/CMakeLists.txt.
set(SECP ${CMAKE_CURRENT_LIST_DIR}/../third_party/secp256k1)
zephyr_library_named(nu54_secp256k1)
zephyr_library_sources(${SECP}/src/secp256k1.c ${SECP}/src/precomputed_ecmult.c ${SECP}/src/precomputed_ecmult_gen.c)
zephyr_library_include_directories(${SECP}/src ${SECP}/include)
zephyr_library_compile_definitions(ENABLE_MODULE_RECOVERY=1 ENABLE_MODULE_ECDH=1 ECMULT_WINDOW_SIZE=4)
# Upstream builds the precomputed tables with unused-function warnings off as well.
zephyr_library_compile_options(-Wno-unused-function)
target_include_directories(app PRIVATE ${SECP}/include)
target_link_libraries(app PRIVATE nu54_secp256k1)

# Development fixed setup (week 7): operator, settlement contract and chain id from the
# deployment record, generated at build time and never typed by hand.
set(DEPLOYMENT ${CMAKE_CURRENT_LIST_DIR}/../../p06-stablenet-contracts/deployments/8283.json)
set(DEV_SETUP_H ${CMAKE_CURRENT_BINARY_DIR}/dev_setup/dev_setup.h)
add_custom_command(OUTPUT ${DEV_SETUP_H}
  COMMAND ${PYTHON_EXECUTABLE} ${CMAKE_CURRENT_LIST_DIR}/gen_dev_setup.py ${DEPLOYMENT} ${DEV_SETUP_H}
  DEPENDS ${CMAKE_CURRENT_LIST_DIR}/gen_dev_setup.py ${DEPLOYMENT})
add_custom_target(dev_setup DEPENDS ${DEV_SETUP_H})
add_dependencies(app dev_setup)
target_include_directories(app PRIVATE ${CMAKE_CURRENT_BINARY_DIR}/dev_setup)
```

## Kconfig
```
# P01 application options.

config NU54_DEV_SETUP
	bool "Week-7 fixed setup when no rental setup is stored"
	default y
	help
	  Without a stored rental setup, create the device key at boot and use the operator,
	  settlement contract and chain id from the deployment record (week-7 gate). Turn it off
	  for the rental build: the device then boots UNPROVISIONED and waits for a setup session.

config NU54_DEV_UNPAIRED_ANCHOR
	bool "Take a TimeAnchor from the unpaired kiosk (development)"
	default y
	help
	  A provisioned device opens a setup session from a central that is not bonded, so the kiosk
	  can hand over a TimeAnchor its development anchor server signed (session vector SV-34).
	  setup.operator still needs a bonded session. The release build turns it off: anchors then
	  come from the operator tool on a bonded link.

config NU54_REQUIRE_SECURE_SESSION
	bool "Refuse plaintext payment sessions"
	help
	  Payment sessions must open the secure channel (payment-protocol.md 4.1); a plaintext
	  session.open in payment mode is answered with error NOT_PERMITTED. The release build turns
	  it on once the kiosk has the channel; development builds keep plaintext for the week-7 path.

config NU54_REQUIRE_PHONE
	bool "Refuse payments and limit changes with no phone app listening"
	help
	  The renter checks what the device signs on the bonded phone app (payment-protocol.md 3).
	  With this on, payment.prepare and limit.change are refused NOT_PERMITTED when no phone app
	  is listening. Development builds go on without one (week-7 path, N30).

source "Kconfig.zephyr"
```

## prj.conf
```kconfig
# Skeleton: console log, LEDs and buttons (board_io.c). Features arrive per WBS
# (P01-02 key, P01-03 BLE, P01-04 signing) as separate Kconfig fragments.
CONFIG_GPIO=y
CONFIG_LOG=y
CONFIG_LOG_MODE_IMMEDIATE=y

# Device key (P01-FR-04): PSA Crypto on CRACEN, a persistent secp256k1 key with deterministic
# ECDSA. Week 7 keeps it in Zephyr Secure storage (no TF-M); week 8 moves it to TF-M ITS.
CONFIG_PSA_CRYPTO=y
CONFIG_PSA_CRYPTO_DRIVER_OBERON=n
CONFIG_PSA_CRYPTO_DRIVER_CRACEN=y
CONFIG_PSA_WANT_ECC_SECP_K1_256=y
CONFIG_PSA_WANT_KEY_TYPE_ECC_KEY_PAIR_GENERATE=y
# Needed for psa_export_public_key on a key pair; the key policy (no EXPORT usage) still keeps
# the private key inside PSA.
CONFIG_PSA_WANT_KEY_TYPE_ECC_KEY_PAIR_EXPORT=y
CONFIG_PSA_WANT_KEY_TYPE_ECC_PUBLIC_KEY=y
CONFIG_PSA_WANT_ALG_DETERMINISTIC_ECDSA=y
CONFIG_PSA_WANT_ALG_HMAC=y
# Rental setup keeps the PIN as an HMAC under a device-held key (device_setup.c).
CONFIG_PSA_WANT_KEY_TYPE_HMAC=y
# Payment session secure channel (payment-protocol.md 4.1): HKDF-SHA256 and AES-128-GCM.
CONFIG_PSA_WANT_ALG_HKDF=y
CONFIG_PSA_WANT_ALG_GCM=y
CONFIG_PSA_WANT_KEY_TYPE_AES=y
CONFIG_PSA_WANT_ALG_SHA_256=y
CONFIG_PSA_WANT_GENERATE_RANDOM=y
CONFIG_MBEDTLS_PSA_CRYPTO_STORAGE_C=y
CONFIG_SECURE_STORAGE=y
CONFIG_FLASH=y
CONFIG_FLASH_PAGE_LAYOUT=y
CONFIG_FLASH_MAP=y
CONFIG_ZMS=y
CONFIG_SETTINGS=y
CONFIG_MBEDTLS_ENABLE_HEAP=y
CONFIG_MBEDTLS_HEAP_SIZE=8192
CONFIG_MAIN_STACK_SIZE=8192

# Payment link (payment-protocol.md 3, 4): BLE peripheral with the payment GATT service, one
# central at a time, ATT_MTU up to 247 so a fragment carries up to 242 envelope bytes.
CONFIG_BT=y
CONFIG_BT_PERIPHERAL=y
CONFIG_BT_DEVICE_NAME="NU54-HW-Wallet"
# GAP Appearance: Generic Keyring (0x0240), the nearest assigned category for a hardware wallet.
CONFIG_BT_DEVICE_APPEARANCE=576
# Two centrals at once: the unpaired kiosk and a bonded phone app or operator tool.
CONFIG_BT_MAX_CONN=2
# Bonds (payment-protocol.md 3): LE Secure Connections only, the label passkey from the app,
# kept in settings and removed by device.reset.
CONFIG_BT_SMP=y
CONFIG_BT_SMP_SC_PAIR_ONLY=y
CONFIG_BT_APP_PASSKEY=y
CONFIG_BT_SMP_APP_PAIRING_ACCEPT=y
CONFIG_BT_SETTINGS=y
CONFIG_BT_MAX_PAIRED=4
CONFIG_BT_L2CAP_TX_MTU=247
CONFIG_BT_BUF_ACL_RX_SIZE=251
CONFIG_BT_BUF_ACL_TX_SIZE=251
CONFIG_BT_CTLR_DATA_LENGTH_MAX=251
CONFIG_SETTINGS_RUNTIME=y
```

## approtect.conf
```kconfig
# Debug lock (P01-NFR-02, W12-10), added with --approtect for the bootloader and the app. Only
# an erase-all through the debug port opens the board again, which removes the device key and
# setup; with one board this runs once, at the end of week 12, after the NVM dump test.
CONFIG_NRF_APPROTECT_LOCK=y
CONFIG_NRF_SECURE_APPROTECT_LOCK=y
```

## release.conf
```kconfig
# Release application (python3 scripts/fw.py build --release): rental setup only, and no console
# or logs, since the UART belongs to MCUboot serial recovery (P01 SRS interfaces).
CONFIG_NU54_DEV_SETUP=n
CONFIG_NU54_DEV_UNPAIRED_ANCHOR=n
CONFIG_NU54_REQUIRE_SECURE_SESSION=y
CONFIG_NU54_REQUIRE_PHONE=y
CONFIG_LOG=n
CONFIG_CONSOLE=n
CONFIG_UART_CONSOLE=n
```

## rental.conf
```kconfig
# Rental build (python3 scripts/fw.py build --rental): no fixed setup, so a device without a
# stored setup boots UNPROVISIONED and waits for an operator setup session.
CONFIG_NU54_DEV_SETUP=n
# The kiosk still hands over development anchors (CONFIG_NU54_DEV_UNPAIRED_ANCHOR, default on).
```

## sysbuild-release.conf
```kconfig
# Release build (python3 scripts/fw.py build --release): MCUboot boots only images signed with
# the offline key (P01-FR-15). The key path comes from NU54_SIGNING_KEY, never from this
# repository; the vendor and MCUboot sample keys are public.
SB_CONFIG_BOOTLOADER_MCUBOOT=y
SB_CONFIG_BOOT_SIGNATURE_TYPE_ED25519=y
# Updates arrive only over wired serial recovery, which writes the one application slot.
SB_CONFIG_MCUBOOT_MODE_SINGLE_APP=y
```

## src/main.c
```c
/*
 * P01 payment signer firmware (week-7 development build).
 *
 * Boot: load the stored setup and start the payment link (device_setup.c), then run the key
 * self-test when the device holds a key.
 * Buttons: long-press SW4 enters payment mode (advertising), long-press SW3 pairing mode (a new
 * bond for the phone app or operator tool), SW1 approves and SW2 rejects a payment waiting on
 * the device. While the session asks for the PIN the buttons enter it instead
 * (core/nu54_pin_entry.h: SW1 taps a digit, SW3 keeps it, SW2 starts again; the lamp flashes for
 * each, app/src/status_led.h). LEDs: LED1 payment mode, LED2 waiting for the button, LED3
 * approved, LED4 refused or failed. Every step is logged on the VCOM console.
 */
#include <zephyr/kernel.h>
#include <zephyr/logging/log.h>

#include <string.h>

#include "board_io.h"
#include "device_key.h"
#include "pay_link.h"
#include "status_led.h"
#include "nu54_keccak.h"
#include "nu54_pin_entry.h"
#include "nu54_protocol.h"
#include "nu54_sig.h"

LOG_MODULE_REGISTER(nu54_signer, LOG_LEVEL_INF);

static void log_hex(const char *what, const uint8_t *b, size_t n)
{
	char s[2 * 65 + 1];
	for (size_t i = 0; i < n && i < 65; i++) {
		static const char d[] = "0123456789abcdef";
		s[2 * i] = d[b[i] >> 4];
		s[2 * i + 1] = d[b[i] & 15];
	}
	s[2 * (n < 65 ? n : 65)] = 0;
	LOG_INF("%s 0x%s", what, s);
}

/* Device key self-test: sign a fixed digest, finish (low-s, v) and recover our own address. */
static void key_self_test(const uint8_t address[20])
{
	static const char probe[] = "nu54 device key self-test";
	uint8_t digest[32], rs[64], sig[65], back[20];
	nu54_keccak256((const uint8_t *)probe, sizeof(probe) - 1, digest);
	int st = device_key_sign(digest, rs);
	if (st != 0) {
		LOG_ERR("key self-test: sign failed (%d)", st);
		return;
	}
	if (nu54_sig_finish(digest, rs, address, sig) != NU54_SIG_OK || nu54_sig_recover(digest, sig, 65, back) != NU54_SIG_OK ||
	    memcmp(back, address, 20) != 0) {
		LOG_ERR("key self-test: signature does not recover to the device address");
		return;
	}
	log_hex("key self-test digest", digest, 32);
	log_hex("key self-test signature", sig, 65);
}

/* The lamp acknowledges each button: a tap flashes short, keeping a digit flashes long. */
static void pin_feedback(bool tap)
{
	status_led_pin(tap ? STATUS_PIN_TAP : STATUS_PIN_KEEP);
}

/* Set when an entry was handed to the session, until the session stops asking: the session works
 * on its own queue, so the next loop may still see the PIN asked for. */
static bool handed_over;

/* The entry as it stands, for the phone app (pin.entry, N28). */
static void show_entry(const nu54_pin_entry_t *e)
{
	char digits[NU54_PIN_LEN + 1];
	int position = nu54_pin_entry_view(e, digits);
	pay_link_pin_progress(digits, position);
	memset(digits, 0, sizeof(digits));
}

static void hand_over(const char *pin)
{
	status_led_pin_end();
	pay_link_pin(pin, pin ? NU54_PIN_LEN : 0);
	handed_over = true;
}

/* A button while the PIN is asked for. Never logs the digits. */
static void pin_button(nu54_pin_entry_t *e, const board_button_event_t *ev)
{
	char pin[NU54_PIN_LEN + 1];
	nu54_pin_event_t pe;

	if (ev->event != NU54_BTN_CLICK || ev->button == 3) {
		return;
	}
	pe = ev->button == 0 ? NU54_PIN_TAP : ev->button == 2 ? NU54_PIN_NEXT : NU54_PIN_CLEAR;
	switch (nu54_pin_entry_event(e, pe, k_uptime_get_32(), pin)) {
	case NU54_PIN_DONE:
		pay_link_pin_progress(pin, NU54_PIN_LEN); /* all four kept */
		hand_over(pin);
		memset(pin, 0, sizeof(pin));
		break;
	case NU54_PIN_TIMEOUT:
		hand_over(NULL);
		break;
	default:
		if (pe != NU54_PIN_CLEAR) {
			pin_feedback(pe == NU54_PIN_TAP);
		} else {
			status_led_pin(STATUS_PIN_START); /* starting again looks like starting */
		}
		show_entry(e);
	}
}

int main(void)
{
	static nu54_pin_entry_t pin_entry;
	uint8_t address[20];

	LOG_INF("nu54 signer, protocol v%d, %d reason codes", NU54_PROTOCOL_VERSION, NU54_REASON_COUNT);
	if (board_io_init() != 0) {
		return 0;
	}
	int st = pay_link_init();
	if (st != 0) {
		LOG_ERR("payment link unavailable (%d)", st);
		return 0;
	}
	if (pay_link_address(address)) {
		log_hex("device address", address, 20);
		key_self_test(address);
	}
	/* Week-7 development mapping (design 3): SW4 long press enters payment mode, SW1 approves,
	 * SW2 rejects. The final layout comes with the PIN LED guidance design. */
	LOG_INF("ready: long-press SW4 for payment mode, SW3 for pairing; SW1 approves, SW2 rejects");

	while (true) {
		board_button_event_t ev;
		bool wanted = pay_link_pin_wanted();

		/* The session asks for the PIN (setup or a limit change): start, or end a stale entry. */
		if (!wanted) {
			handed_over = false;
		}
		if (wanted && !pin_entry.active && !handed_over) {
			nu54_pin_entry_start(&pin_entry, k_uptime_get_32());
			LOG_INF("enter the PIN: SW1 taps a digit, SW3 keeps it, SW2 starts again");
			status_led_pin(STATUS_PIN_START);
			show_entry(&pin_entry);
		} else if (!wanted && pin_entry.active) {
			nu54_pin_entry_stop(&pin_entry);
			status_led_pin_end();
		}
		if (pin_entry.active && nu54_pin_entry_poll(&pin_entry, k_uptime_get_32()) == NU54_PIN_TIMEOUT) {
			hand_over(NULL);
			continue;
		}
		/* Poll while the session waits for the renter, so the PIN entry starts as soon as the
		 * session asks for it (right after the approve button) and a timeout or a closed
		 * session is noticed. */
		if (board_button_wait(&ev, wanted || pin_entry.active || pay_link_waiting() ? 250 : -1) != 0) {
			continue;
		}
		if (pin_entry.active) {
			pin_button(&pin_entry, &ev);
			continue;
		}
		LOG_INF("SW%u %s", ev.button + 1, ev.event == NU54_BTN_CLICK ? "click" : "long press");
		if (ev.button == 3 && ev.event == NU54_BTN_LONG) {
			status_led_clear();
			pay_link_payment_mode(120);
		} else if (ev.button == 2 && ev.event == NU54_BTN_LONG) {
			pay_link_pairing_mode(120); /* LE limited discovery stays under the 180 s the GAP allows */
		} else if (ev.button == 0 && ev.event == NU54_BTN_CLICK) {
			pay_link_button(1);
		} else if (ev.button == 1 && ev.event == NU54_BTN_CLICK) {
			pay_link_button(0);
		} else if (ev.button <= 1) {
			LOG_WRN("SW%u was held: approve and reject need a short press", ev.button + 1);
		}
	}
	return 0;
}
```

## src/ble_links.c
```c
#include "ble_links.h"

#include <errno.h>
#include <string.h>

#include <psa/crypto.h>
#include <zephyr/bluetooth/bluetooth.h>
#include <zephyr/bluetooth/conn.h>
#include <zephyr/bluetooth/gatt.h>
#include <zephyr/bluetooth/uuid.h>
#include <zephyr/kernel.h>
#include <zephyr/logging/log.h>
#include <zephyr/settings/settings.h>

#include "nu54_frame.h"
#include "nu54_protocol.h"
#include "status_led.h"

LOG_MODULE_REGISTER(ble_links, LOG_LEVEL_INF);

#define FRAGMENT_MAX BLE_LINKS_FRAGMENT_MAX
#define LINK_MAX CONFIG_BT_MAX_CONN

/* One connected central. Changed on Bluetooth threads under the lock; read with link_conn(). */
typedef struct {
	struct bt_conn *conn;
	uint8_t tx_sequence; /* send side only (session work queue) */
} link_t;

static link_t links[LINK_MAX];
static struct k_spinlock links_lock;
static const ble_links_handlers_t *handlers;

static int link_of(const struct bt_conn *conn)
{
	k_spinlock_key_t key = k_spin_lock(&links_lock);
	int found = -1;
	for (int i = 0; i < LINK_MAX && found < 0; i++) {
		found = links[i].conn == conn ? i : -1;
	}
	k_spin_unlock(&links_lock, key);
	return found;
}

/* A reference to link i's connection, or NULL; the caller unrefs it. */
static struct bt_conn *link_conn(int i)
{
	if (i < 0 || i >= LINK_MAX) {
		return NULL;
	}
	k_spinlock_key_t key = k_spin_lock(&links_lock);
	struct bt_conn *c = links[i].conn ? bt_conn_ref(links[i].conn) : NULL;
	k_spin_unlock(&links_lock, key);
	return c;
}

/* ---------------------------------------------------------------- GATT */

/* One more expansion step, so the generated UUID parts become five macro arguments. */
#define UUID128(...) BT_UUID_128_ENCODE(__VA_ARGS__)

static const struct bt_uuid_128 svc_uuid = BT_UUID_INIT_128(UUID128(NU54_GATT_SERVICE_UUID_PARTS));
static const struct bt_uuid_128 rx_uuid = BT_UUID_INIT_128(UUID128(NU54_GATT_RX_UUID_PARTS));
static const struct bt_uuid_128 tx_uuid = BT_UUID_INIT_128(UUID128(NU54_GATT_TX_UUID_PARTS));

static ssize_t rx_write(struct bt_conn *conn, const struct bt_gatt_attr *attr, const void *buf, uint16_t len, uint16_t offset,
			uint8_t flags)
{
	int i = link_of(conn);
	(void)attr;
	(void)flags;
	if (i < 0 || offset != 0 || len > FRAGMENT_MAX) {
		return BT_GATT_ERR(BT_ATT_ERR_INVALID_ATTRIBUTE_LEN);
	}
	if (handlers->fragment(i, buf, len) != 0) {
		return BT_GATT_ERR(BT_ATT_ERR_INSUFFICIENT_RESOURCES);
	}
	return len;
}

/* The CCC callback does not say which central; listening() asks per connection when it matters. */
static void ccc_changed(const struct bt_gatt_attr *attr, uint16_t value)
{
	(void)attr;
	LOG_DBG("notifications %s", value == BT_GATT_CCC_NOTIFY ? "on" : "off");
}

BT_GATT_SERVICE_DEFINE(pay_svc, BT_GATT_PRIMARY_SERVICE(&svc_uuid),
		       BT_GATT_CHARACTERISTIC(&rx_uuid.uuid, BT_GATT_CHRC_WRITE | BT_GATT_CHRC_WRITE_WITHOUT_RESP, BT_GATT_PERM_WRITE,
					      NULL, rx_write, NULL),
		       BT_GATT_CHARACTERISTIC(&tx_uuid.uuid, BT_GATT_CHRC_NOTIFY, BT_GATT_PERM_NONE, NULL, NULL, NULL),
		       BT_GATT_CCC(ccc_changed, BT_GATT_PERM_READ | BT_GATT_PERM_WRITE));

bool ble_links_listening(int i)
{
	struct bt_conn *c = link_conn(i);
	bool on = c && bt_gatt_is_subscribed(c, &pay_svc.attrs[4], BT_GATT_CCC_NOTIFY);
	if (c) {
		bt_conn_unref(c);
	}
	return on;
}

/*
 * Two advertising sets (payment-protocol.md 3). Both a passive scanner (the advertising packet
 * only) and an active one (also the scan response) must find the device and learn what it is,
 * so whatever a central filters on sits in the advertising packet itself.
 *
 * Payment mode is for the one kiosk paying now: no discoverable flag, no name, no appearance,
 * only the payment service UUID the kiosk filters on, so generic scanners and OS settings have
 * nothing to show.
 *
 * Pairing mode is for the renter finding the device: LE Limited Discoverable (a short,
 * button-opened window), the service UUID and the name. The 31-byte packet holds the flags (3),
 * the 128-bit UUID (18) and the first 8 characters of the name as the Shortened Local Name (10);
 * the scan response adds the complete name and the appearance.
 */
#define SHORT_NAME_LEN 8
BUILD_ASSERT(sizeof(CONFIG_BT_DEVICE_NAME) - 1 >= SHORT_NAME_LEN, "the shortened name is a prefix of the name");

static const struct bt_data ad_payment[] = {
	BT_DATA_BYTES(BT_DATA_FLAGS, BT_LE_AD_NO_BREDR),
	BT_DATA_BYTES(BT_DATA_UUID128_ALL, UUID128(NU54_GATT_SERVICE_UUID_PARTS)),
};
static const struct bt_data ad_pairing[] = {
	BT_DATA_BYTES(BT_DATA_FLAGS, (BT_LE_AD_LIMITED | BT_LE_AD_NO_BREDR)),
	BT_DATA_BYTES(BT_DATA_UUID128_ALL, UUID128(NU54_GATT_SERVICE_UUID_PARTS)),
	BT_DATA(BT_DATA_NAME_SHORTENED, CONFIG_BT_DEVICE_NAME, SHORT_NAME_LEN),
};
static const struct bt_data sd_pairing[] = {
	BT_DATA(BT_DATA_NAME_COMPLETE, CONFIG_BT_DEVICE_NAME, sizeof(CONFIG_BT_DEVICE_NAME) - 1),
	BT_DATA_BYTES(BT_DATA_GAP_APPEARANCE, (CONFIG_BT_DEVICE_APPEARANCE & 0xff), (CONFIG_BT_DEVICE_APPEARANCE >> 8)),
};

bool ble_links_bonded(int i, bool need_passkey)
{
	struct bt_conn *c = link_conn(i);
	struct bt_conn_info info;
	bool ok = false;

	if (c && bt_conn_get_info(c, &info) == 0) {
		ok = info.security.level >= (need_passkey ? BT_SECURITY_L4 : BT_SECURITY_L2) && (info.security.flags & BT_SECURITY_FLAG_SC);
	}
	if (c) {
		bt_conn_unref(c);
	}
	return ok;
}

/* ---------------------------------------------------------------- advertising and modes */

static bool payment_mode;
static bool pairing_mode;
static uint32_t pairing_passkey;

static void mode_end(struct k_work *w);
static K_WORK_DELAYABLE_DEFINE(mode_timer, mode_end);
static void pairing_end(struct k_work *w);
static K_WORK_DELAYABLE_DEFINE(pairing_timer, pairing_end);

typedef enum { ADV_NONE, ADV_PAYMENT, ADV_PAIRING } adv_set_t;
static adv_set_t advertising; /* the set on air */

/* Advertises the set the modes call for while a connection slot is free; pairing wins when both
 * are on (it carries the service UUID too). A change of set restarts advertising. */
static int advertise(void)
{
	bool free_slot = false;
	for (int i = 0; i < LINK_MAX; i++) {
		struct bt_conn *c = link_conn(i);
		free_slot |= c == NULL;
		if (c) {
			bt_conn_unref(c);
		}
	}
	adv_set_t want = !free_slot ? ADV_NONE : pairing_mode ? ADV_PAIRING : payment_mode ? ADV_PAYMENT : ADV_NONE;
	if (want == advertising) {
		return 0;
	}
	bt_le_adv_stop();
	advertising = ADV_NONE;
	if (want == ADV_NONE) {
		return 0;
	}
	int err = want == ADV_PAIRING
			  ? bt_le_adv_start(BT_LE_ADV_CONN_FAST_1, ad_pairing, ARRAY_SIZE(ad_pairing), sd_pairing, ARRAY_SIZE(sd_pairing))
			  : bt_le_adv_start(BT_LE_ADV_CONN_FAST_1, ad_payment, ARRAY_SIZE(ad_payment), NULL, 0);
	if (err && err != -EALREADY) {
		return err;
	}
	advertising = want;
	LOG_INF("advertising for %s", want == ADV_PAIRING ? "pairing" : "payment");
	return 0;
}

/* A mode ended: advertise what is left, or stop. */
static void stop_advertising_if_idle(void)
{
	advertise();
}

static void mode_end(struct k_work *w)
{
	(void)w;
	payment_mode = false;
	stop_advertising_if_idle();
	status_led_mode(false);
	LOG_INF("payment mode ended");
}

static void pairing_end(struct k_work *w)
{
	(void)w;
	pairing_mode = false;
	stop_advertising_if_idle();
	status_led_pairing(false);
	LOG_INF("pairing mode ended");
}

int ble_links_payment_mode(uint32_t seconds)
{
	if (seconds == 0) {
		k_work_cancel_delayable(&mode_timer);
		mode_end(NULL);
		return 0;
	}
	payment_mode = true;
	int err = advertise();
	if (err) {
		payment_mode = false;
		LOG_ERR("advertising failed (%d)", err);
		return err;
	}
	status_led_mode(true);
	k_work_reschedule(&mode_timer, K_SECONDS(seconds));
	LOG_INF("payment mode for %u s", seconds);
	return 0;
}

/* ---------------------------------------------------------------- connections */

static void connected(struct bt_conn *conn, uint8_t err)
{
	int i = link_of(NULL);
	if (err || i < 0) {
		return;
	}
	k_spinlock_key_t key = k_spin_lock(&links_lock);
	links[i] = (link_t){.conn = bt_conn_ref(conn)};
	k_spin_unlock(&links_lock, key);
	LOG_INF("central connected (link %d)", i);
	handlers->connected(i);
	advertising = ADV_NONE; /* a connection stops connectable advertising */
	advertise();            /* room for the other central */
}

/* An UNPROVISIONED device keeps a (Just Works) bond only while that central sets it up. When the
 * central leaves before setup stored a key (refused, timed out, app closed), its bond goes too:
 * the stack would refuse the next Just Works pairing over the old unauthenticated keys. */
static bool unprovisioned_auth;
static bt_addr_le_t setup_leaver;

static void drop_setup_bond(struct k_work *w)
{
	(void)w;
	if (unprovisioned_auth && bt_unpair(BT_ID_DEFAULT, &setup_leaver) == 0) {
		LOG_INF("unprovisioned: bond of the central that left removed");
	}
}
static K_WORK_DEFINE(drop_setup_bond_work, drop_setup_bond);

static void disconnected(struct bt_conn *conn, uint8_t reason)
{
	int i = link_of(conn);
	if (i < 0) {
		return;
	}
	k_spinlock_key_t key = k_spin_lock(&links_lock);
	struct bt_conn *c = links[i].conn;
	links[i] = (link_t){0};
	k_spin_unlock(&links_lock, key);
	bt_conn_unref(c);
	LOG_INF("central disconnected (link %d, 0x%02x)", i, reason);
	if (unprovisioned_auth) {
		bt_addr_le_copy(&setup_leaver, bt_conn_get_dst(conn));
		k_work_submit(&drop_setup_bond_work);
	}
	handlers->disconnected(i);
	advertise();
}

static void security_changed(struct bt_conn *conn, bt_security_t level, enum bt_security_err err)
{
	LOG_INF("link %d security level %d (%d)", link_of(conn), (int)level, (int)err);
}

BT_CONN_CB_DEFINE(conn_cb) = {
	.connected = connected,
	.disconnected = disconnected,
	.security_changed = security_changed,
};

/* ---------------------------------------------------------------- pairing (payment-protocol.md 3) */

/* New bonds only in pairing mode; the renter opens it on the device. */
static enum bt_security_err pairing_accept(struct bt_conn *conn, const struct bt_conn_pairing_feat *const feat)
{
	(void)conn;
	(void)feat;
	return pairing_mode ? BT_SECURITY_ERR_SUCCESS : BT_SECURITY_ERR_PAIR_NOT_ALLOWED;
}

/* The label passkey recorded at setup; the device has no screen, so it "displays" it on the label. */
static uint32_t app_passkey(struct bt_conn *conn)
{
	(void)conn;
	return pairing_passkey;
}

static void passkey_display(struct bt_conn *conn, unsigned int passkey)
{
	(void)passkey; /* never logged: it is the label secret */
	LOG_INF("pairing link %d: the central enters the label passkey", link_of(conn));
}

static void auth_cancel(struct bt_conn *conn)
{
	LOG_INF("pairing link %d cancelled", link_of(conn));
}

static struct bt_conn_auth_cb auth_passkey = {
	.pairing_accept = pairing_accept,
	.passkey_display = passkey_display,
	.app_passkey = app_passkey,
	.cancel = auth_cancel,
};

/* UNPROVISIONED: no passkey yet; the first setup bonds with Just Works and the button confirms. */
static struct bt_conn_auth_cb auth_just_works = {
	.pairing_accept = pairing_accept,
	.cancel = auth_cancel,
};

/* One owner (payment-protocol.md 3): a new bond replaces every older one, so a phone the device
 * was bonded with before (or the operator tool) no longer gets confirm.show. bt_unpair also drops
 * a connected central; it runs off the Bluetooth thread. */
static bt_addr_le_t new_owner;

struct bond_list {
	bt_addr_le_t addr[CONFIG_BT_MAX_PAIRED];
	int n;
};

static void collect_bond(const struct bt_bond_info *info, void *data)
{
	struct bond_list *l = data;
	if (l->n < CONFIG_BT_MAX_PAIRED && !bt_addr_le_eq(&info->addr, &new_owner)) {
		l->addr[l->n++] = info->addr;
	}
}

static void drop_old_bonds(struct k_work *w)
{
	struct bond_list l = {.n = 0};
	(void)w;
	bt_foreach_bond(BT_ID_DEFAULT, collect_bond, &l);
	for (int i = 0; i < l.n; i++) {
		(void)bt_unpair(BT_ID_DEFAULT, &l.addr[i]);
	}
	if (l.n) {
		LOG_INF("%d older bond(s) removed: one owner", l.n);
	}
}
static K_WORK_DEFINE(drop_bonds_work, drop_old_bonds);

static void pairing_complete(struct bt_conn *conn, bool bonded)
{
	LOG_INF("pairing link %d complete (%s)", link_of(conn), bonded ? "bonded" : "not bonded");
	status_led_paired(bonded);
	if (bonded) {
		bt_addr_le_copy(&new_owner, bt_conn_get_dst(conn));
		k_work_submit(&drop_bonds_work);
		k_work_reschedule(&pairing_timer, K_NO_WAIT); /* one bond per pairing mode */
	}
}

static void pairing_failed(struct bt_conn *conn, enum bt_security_err reason)
{
	LOG_WRN("pairing link %d failed (%d)", link_of(conn), (int)reason);
	status_led_paired(false);
}

static struct bt_conn_auth_info_cb auth_info = {
	.pairing_complete = pairing_complete,
	.pairing_failed = pairing_failed,
};

static void auth_select(bool just_works)
{
	unprovisioned_auth = just_works;
	bt_conn_auth_cb_register(NULL);
	bt_conn_auth_cb_register(just_works ? &auth_just_works : &auth_passkey);
}

int ble_links_pairing_mode(uint32_t seconds, uint32_t passkey, bool just_works)
{
	pairing_passkey = passkey;
	auth_select(just_works);
	pairing_mode = true;
	int err = advertise();
	if (err) {
		pairing_mode = false;
		LOG_ERR("advertising failed (%d)", err);
		return err;
	}
	status_led_pairing(true);
	k_work_reschedule(&pairing_timer, K_SECONDS(seconds));
	LOG_INF("pairing mode for %u s (%s)", seconds, just_works ? "Just Works" : "label passkey");
	return 0;
}

int ble_links_unpair_all(void)
{
	return bt_is_ready() ? bt_unpair(BT_ID_DEFAULT, BT_ADDR_LE_ANY) : 0;
}

/* ---------------------------------------------------------------- framing out */

int ble_links_send(int i, const uint8_t *body, size_t len)
{
	static uint8_t env[NU54_MAX_ENVELOPE_LEN];
	uint8_t digest[32], frag[FRAGMENT_MAX];
	size_t dlen;
	int rc = -ENOTCONN;
	struct bt_conn *c = link_conn(i);

	if (!c || !bt_gatt_is_subscribed(c, &pay_svc.attrs[4], BT_GATT_CCC_NOTIFY)) {
		LOG_WRN("reply dropped: link %d is not listening", i);
		goto out;
	}
	rc = -EINVAL;
	if (psa_hash_compute(PSA_ALG_SHA_256, body, len, digest, sizeof(digest), &dlen) != PSA_SUCCESS ||
	    nu54_envelope_header(env, len, digest) != 0) {
		goto out;
	}
	memcpy(&env[NU54_ENVELOPE_HEADER_LEN], body, len);
	size_t total = NU54_ENVELOPE_HEADER_LEN + len;
	size_t chunk = nu54_fragment_payload(bt_gatt_get_mtu(c));
	if (chunk > FRAGMENT_MAX - NU54_FRAGMENT_HEADER_LEN) {
		chunk = FRAGMENT_MAX - NU54_FRAGMENT_HEADER_LEN;
	}
	uint8_t index = 0;
	for (size_t off = 0; off < total; off += chunk, index++) {
		size_t n = total - off < chunk ? total - off : chunk;
		frag[0] = links[i].tx_sequence;
		frag[1] = index;
		memcpy(&frag[2], &env[off], n);
		while ((rc = bt_gatt_notify(c, &pay_svc.attrs[4], frag, n + 2)) == -ENOMEM) {
			k_sleep(K_MSEC(5)); /* wait for a TX buffer */
		}
		if (rc) {
			LOG_WRN("notify failed (%d)", rc);
			goto out;
		}
	}
	links[i].tx_sequence++;
out:
	if (c) {
		bt_conn_unref(c);
	}
	return rc;
}

/* ---------------------------------------------------------------- init */

int ble_links_init(const ble_links_handlers_t *h, uint32_t passkey, bool just_works)
{
	int err;

	handlers = h;
	err = bt_enable(NULL);
	if (!err) {
		err = settings_load_subtree("bt"); /* bonds (CONFIG_BT_SETTINGS) */
	}
	if (!err && just_works) {
		/* No key: any bond left is from a previous rental or a setup that did not finish (a wipe
		 * at boot runs before Bluetooth is up and cannot remove it). An old passkey bond would
		 * refuse the new Just Works one, so the device starts with none. */
		err = bt_unpair(BT_ID_DEFAULT, BT_ADDR_LE_ANY);
		LOG_INF("unprovisioned: bonds cleared (%d)", err);
	}
	if (!err) {
		err = bt_conn_auth_info_cb_register(&auth_info);
	}
	if (!err) {
		pairing_passkey = passkey;
		auth_select(just_works); /* pairing_accept refuses outside pairing mode */
	}
	return err;
}
```

## src/ble_links.h
```c
/*
 * The BLE side of the payment link (payment-protocol.md 3, 4): the payment GATT service, up to
 * two centrals, pairing (LE Secure Connections with the label passkey, or Just Works while
 * UNPROVISIONED), payment and pairing modes (advertising), and fragmenting a body out to one
 * central. The connection table is this module's alone; callers name centrals by link index.
 *
 * The handlers run on Bluetooth threads and must only hand work over (pay_link.c queues them).
 * Every other function is called from the session work queue.
 */
#ifndef BLE_LINKS_H
#define BLE_LINKS_H

#include <stdbool.h>
#include <stddef.h>
#include <stdint.h>

#define BLE_LINKS_FRAGMENT_MAX 247

typedef struct {
	void (*connected)(int link);
	void (*disconnected)(int link);
	/* One fragment written to RX. Returns 0, or nonzero when it could not be queued (the write
	 * is then refused with an ATT error). */
	int (*fragment)(int link, const uint8_t *data, uint16_t len);
} ble_links_handlers_t;

/* Starts Bluetooth and loads the bonds. `passkey` and `just_works` set how pairing mode pairs. */
int ble_links_init(const ble_links_handlers_t *h, uint32_t passkey, bool just_works);

/* Frames one body (envelope and fragments for the link's ATT_MTU) and notifies it. */
int ble_links_send(int link, const uint8_t *body, size_t len);

/* Link is bonded with LE Secure Connections: passkey-authenticated (need_passkey) or any LESC bond. */
bool ble_links_bonded(int link, bool need_passkey);

/* Link subscribed to TX notifications. */
bool ble_links_listening(int link);

/* Payment mode: advertise the payment service for `seconds`; 0 ends it. */
int ble_links_payment_mode(uint32_t seconds);

/* Pairing mode: accept a new bond for `seconds`, with the label passkey or Just Works. */
int ble_links_pairing_mode(uint32_t seconds, uint32_t passkey, bool just_works);

/* Remove every bond (device.reset). Safe before Bluetooth is up. */
int ble_links_unpair_all(void);

#endif /* BLE_LINKS_H */
```

## src/board_io.c
```c
/*
 * GPIO handling for LEDs and buttons.
 *
 * Buttons: press interrupt -> 30 ms debounce work -> while held, a 50 ms poll
 * reads the level, detects the release and the long press through nu54_button
 * (core/) -> event queue read by the application thread. The release is polled
 * rather than taken from a both-edge interrupt: on this SoC the GPIO driver
 * emulates both-edge with SENSE toggling, and in testing the release callback
 * did not arrive reliably.
 * The buttons sit on two GPIO ports (SW4 is P0.04, the others P1.x), so the
 * interrupt handler matches both the port and the pin.
 */
#include "board_io.h"

#include <errno.h>
#include <zephyr/drivers/gpio.h>
#include <zephyr/kernel.h>
#include <zephyr/logging/log.h>
#include <zephyr/sys/atomic.h>

LOG_MODULE_REGISTER(board_io, LOG_LEVEL_INF);

#define DEBOUNCE_MS 30
#define HOLD_POLL_MS 50

static const struct gpio_dt_spec leds[BOARD_IO_COUNT] = {
	GPIO_DT_SPEC_GET(DT_ALIAS(led0), gpios),
	GPIO_DT_SPEC_GET(DT_ALIAS(led1), gpios),
	GPIO_DT_SPEC_GET(DT_ALIAS(led2), gpios),
	GPIO_DT_SPEC_GET(DT_ALIAS(led3), gpios),
};

static const struct gpio_dt_spec buttons[BOARD_IO_COUNT] = {
	GPIO_DT_SPEC_GET(DT_ALIAS(sw0), gpios),
	GPIO_DT_SPEC_GET(DT_ALIAS(sw1), gpios),
	GPIO_DT_SPEC_GET(DT_ALIAS(sw2), gpios),
	GPIO_DT_SPEC_GET(DT_ALIAS(sw3), gpios),
};

static struct gpio_callback button_cb[BOARD_IO_COUNT];
static struct k_work_delayable debounce[BOARD_IO_COUNT];
static struct k_work_delayable hold_poll;
static nu54_button_t state[BOARD_IO_COUNT];
static atomic_t debounce_pending;

K_MSGQ_DEFINE(button_events, sizeof(board_button_event_t), 8, 4);

static void post(uint8_t i, nu54_button_event_t ev)
{
	if (ev == NU54_BTN_NONE) {
		return;
	}
	board_button_event_t msg = {.button = i, .event = ev};
	if (k_msgq_put(&button_events, &msg, K_NO_WAIT) != 0) {
		LOG_WRN("button event dropped (queue full)");
	}
}

static void hold_poll_fn(struct k_work *work)
{
	ARG_UNUSED(work);
	bool any_held = false;
	uint32_t now = k_uptime_get_32();

	for (uint8_t i = 0; i < BOARD_IO_COUNT; i++) {
		if (!state[i].pressed) {
			continue;
		}
		if (gpio_pin_get_dt(&buttons[i]) > 0) {
			post(i, nu54_button_tick(&state[i], now));
			any_held = true;
		} else {
			post(i, nu54_button_update(&state[i], false, now));
		}
	}
	if (any_held) {
		k_work_schedule(&hold_poll, K_MSEC(HOLD_POLL_MS));
	}
}

static void debounce_fn(struct k_work *work)
{
	struct k_work_delayable *dw = k_work_delayable_from_work(work);

	for (uint8_t i = 0; i < BOARD_IO_COUNT; i++) {
		if (dw != &debounce[i]) {
			continue;
		}
		atomic_clear_bit(&debounce_pending, i);
		/* Count the press only if the button is still down after the debounce. */
		if (gpio_pin_get_dt(&buttons[i]) > 0 && !state[i].pressed) {
			nu54_button_update(&state[i], true, k_uptime_get_32());
			k_work_schedule(&hold_poll, K_MSEC(HOLD_POLL_MS));
		}
		return;
	}
}

static void button_isr(const struct device *port, struct gpio_callback *cb, uint32_t pins)
{
	ARG_UNUSED(cb);
	for (uint8_t i = 0; i < BOARD_IO_COUNT; i++) {
		if (buttons[i].port != port || !(pins & BIT(buttons[i].pin))) {
			continue;
		}
		/* One debounce per burst of edges: chatter does not count twice. */
		if (!atomic_test_and_set_bit(&debounce_pending, i)) {
			k_work_schedule(&debounce[i], K_MSEC(DEBOUNCE_MS));
		}
	}
}

int board_io_init(void)
{
	k_work_init_delayable(&hold_poll, hold_poll_fn);

	for (uint8_t i = 0; i < BOARD_IO_COUNT; i++) {
		if (!gpio_is_ready_dt(&leds[i]) || !gpio_is_ready_dt(&buttons[i])) {
			LOG_ERR("GPIO for LED%u or SW%u not ready", i + 1, i + 1);
			return -ENODEV;
		}
		int err = gpio_pin_configure_dt(&leds[i], GPIO_OUTPUT_INACTIVE);
		err = err ? err : gpio_pin_configure_dt(&buttons[i], GPIO_INPUT);
		err = err ? err : gpio_pin_interrupt_configure_dt(&buttons[i], GPIO_INT_EDGE_TO_ACTIVE);
		if (err) {
			LOG_ERR("SW%u/LED%u configure failed (%d)", i + 1, i + 1, err);
			return err;
		}
		nu54_button_reset(&state[i]);
		k_work_init_delayable(&debounce[i], debounce_fn);
		gpio_init_callback(&button_cb[i], button_isr, BIT(buttons[i].pin));
		gpio_add_callback(buttons[i].port, &button_cb[i]);
		LOG_INF("LED%u %s pin %u, SW%u %s pin %u", i + 1, leds[i].port->name, leds[i].pin, i + 1,
			buttons[i].port->name, buttons[i].pin);
	}
	return 0;
}

void board_led_set(uint8_t led, bool on)
{
	if (led < BOARD_IO_COUNT) {
		gpio_pin_set_dt(&leds[led], on);
	}
}

void board_led_toggle(uint8_t led)
{
	if (led < BOARD_IO_COUNT) {
		gpio_pin_toggle_dt(&leds[led]);
	}
}

int board_button_wait(board_button_event_t *out, int32_t timeout_ms)
{
	return k_msgq_get(&button_events, out, timeout_ms < 0 ? K_FOREVER : K_MSEC(timeout_ms));
}
```

## src/board_io.h
```c
/*
 * LEDs and buttons of the NU-54V-DK, reached through devicetree aliases
 * (led0..led3, sw0..sw3) so the pin numbers stay in the board package.
 */
#ifndef BOARD_IO_H
#define BOARD_IO_H

#include <stdbool.h>
#include <stdint.h>

#include "nu54_button.h"

#define BOARD_IO_COUNT 4

typedef struct {
	uint8_t button;             /* 0..3 = SW1..SW4 */
	nu54_button_event_t event;  /* CLICK or LONG */
} board_button_event_t;

int board_io_init(void);
void board_led_set(uint8_t led, bool on);
void board_led_toggle(uint8_t led);

/* Wait for the next button gesture. Returns 0, or -EAGAIN on timeout. */
int board_button_wait(board_button_event_t *out, int32_t timeout_ms);

#endif /* BOARD_IO_H */
```

## src/device_key.c
```c
#include "device_key.h"

#include <psa/crypto.h>
#include <zephyr/logging/log.h>

#include "nu54_sig.h"

/* One persistent key per device; reset (DeviceReset) destroys it. */
#define DEVICE_KEY_ID ((psa_key_id_t)0x00005401)
#define SIGN_ALG PSA_ALG_DETERMINISTIC_ECDSA(PSA_ALG_SHA_256)

LOG_MODULE_REGISTER(device_key, LOG_LEVEL_INF);

static int missing(psa_status_t st)
{
	return st == PSA_ERROR_INVALID_HANDLE || st == PSA_ERROR_DOES_NOT_EXIST;
}

int device_key_open(uint8_t address[20])
{
	uint8_t pub[65];
	size_t pub_len;
	psa_status_t st = psa_export_public_key(DEVICE_KEY_ID, pub, sizeof(pub), &pub_len);

	LOG_DBG("export public key: %d (%u bytes)", st, (unsigned)pub_len);
	if (st != PSA_SUCCESS || pub_len != 65) {
		return st != PSA_SUCCESS ? st : PSA_ERROR_GENERIC_ERROR;
	}
	nu54_address_of_pubkey(pub, address);
	return 0;
}

int device_key_generate(uint8_t address[20])
{
	psa_key_attributes_t attr = PSA_KEY_ATTRIBUTES_INIT;
	psa_key_id_t id;
	psa_status_t st = device_key_destroy();

	if (st != PSA_SUCCESS) {
		return st;
	}
	psa_set_key_id(&attr, DEVICE_KEY_ID);
	psa_set_key_lifetime(&attr, PSA_KEY_LIFETIME_PERSISTENT);
	psa_set_key_type(&attr, PSA_KEY_TYPE_ECC_KEY_PAIR(PSA_ECC_FAMILY_SECP_K1));
	psa_set_key_bits(&attr, 256);
	psa_set_key_usage_flags(&attr, PSA_KEY_USAGE_SIGN_HASH); /* not exportable */
	psa_set_key_algorithm(&attr, SIGN_ALG);
	st = psa_generate_key(&attr, &id);
	psa_reset_key_attributes(&attr);
	LOG_INF("generate: %d", st);
	return st != PSA_SUCCESS ? st : device_key_open(address);
}

int device_key_destroy(void)
{
	psa_status_t st = psa_destroy_key(DEVICE_KEY_ID);
	return st == PSA_SUCCESS || missing(st) ? 0 : st;
}

int device_key_init(uint8_t address[20], int *created)
{
	psa_status_t st = psa_crypto_init();

	if (st != PSA_SUCCESS) {
		return st;
	}
	st = device_key_open(address);
	*created = missing(st);
	return *created ? device_key_generate(address) : st;
}

int device_key_sign(const uint8_t digest[32], uint8_t rs[64])
{
	size_t len;
	psa_status_t st = psa_sign_hash(DEVICE_KEY_ID, SIGN_ALG, digest, 32, rs, 64, &len);
	return st == PSA_SUCCESS && len == 64 ? 0 : (st != PSA_SUCCESS ? st : PSA_ERROR_GENERIC_ERROR);
}
```

## src/device_key.h
```c
/*
 * The device key (payment-protocol.md 2, P01-FR-04). A persistent secp256k1 key made with the
 * TRNG and kept by PSA Crypto (CRACEN); this build keeps it in Zephyr Secure storage, the TF-M
 * build moves it to encrypted ITS. The key never leaves PSA: callers get the address and raw
 * (r, s) signatures of 32-byte digests.
 */
#ifndef DEVICE_KEY_H
#define DEVICE_KEY_H

#include <stdint.h>

/* Week-7 fixed setup: opens the key, creating it on first boot. Returns 0 and the address, or a
 * negative PSA status. */
int device_key_init(uint8_t address[20], int *created);

/* Opens the existing key. Returns 0 and the address, or a PSA status (PSA_ERROR_INVALID_HANDLE
 * when there is no key). */
int device_key_open(uint8_t address[20]);

/* Rental setup: makes a new key in place of any old one. Returns 0 and the address, or a PSA status. */
int device_key_generate(uint8_t address[20]);

/* Destroys the key. Returns 0, also when there was none, or a PSA status. */
int device_key_destroy(void);

/* Deterministic ECDSA (RFC 6979) over a 32-byte digest; raw r || s. Returns 0 or a PSA status. */
int device_key_sign(const uint8_t digest[32], uint8_t rs[64]);

#endif /* DEVICE_KEY_H */
```

## src/device_setup.h
```c
/*
 * What the device keeps across resets and the session's platform callbacks (payment-protocol.md
 * 2, 5): the device key, the setup record, the PIN with its failure counter, and the nonce
 * counter. The record, PIN and counter live in PSA secure storage (Zephyr Secure storage now,
 * TF-M ITS later); the PIN is kept only as an HMAC under a device-held key, never in clear.
 */
#ifndef DEVICE_SETUP_H
#define DEVICE_SETUP_H

#include "nu54_session.h"

/* Fills the platform callbacks of `d` and loads what is stored: a finished rental setup
 * (PROVISIONED_NO_ANCHOR, or PIN_LOCKED), or nothing (UNPROVISIONED, after wiping whatever an
 * unfinished setup left). With CONFIG_NU54_DEV_SETUP a device without a rental setup uses the
 * week-7 fixed setup instead. Returns 0 or a negative error. */
int device_setup_load(nu54_device_t *d);

#endif /* DEVICE_SETUP_H */
```

## src/pay_link.h
```c
/*
 * Payment link: BLE advertising and the GATT service of payment-protocol.md 3, framing of
 * section 4 and the session of sections 5 and 6 (core/nu54_session). All session work runs on
 * one work queue, so messages and button presses never race.
 */
#ifndef PAY_LINK_H
#define PAY_LINK_H

#include <stddef.h>
#include <stdint.h>


/* Loads the stored setup (device_setup.h), then starts the session and BLE. Returns 0 or a
 * negative errno. */
int pay_link_init(void);

/* The device address; returns 1 when the device holds a key (not UNPROVISIONED). */
int pay_link_address(uint8_t address[20]);

/* Enters payment mode: advertise the payment service for `seconds`. */
int pay_link_payment_mode(uint32_t seconds);

/* Pairing mode (payment-protocol.md 3): accept a new bond for `seconds`, with the label passkey
 * (LE Secure Connections Passkey Entry), or Just Works while the device is UNPROVISIONED. */
int pay_link_pairing_mode(uint32_t seconds);

/* The renter's button while a payment waits: 1 approve, 0 reject. */
void pay_link_button(int approve);

/* 1 while the session waits for the PIN (setup key generation or a limit change). */
/* The session waits for the renter (a button or the PIN): the main loop polls so it notices
 * when the PIN is asked for next. */
int pay_link_waiting(void);

/* The PIN entry as it stands after a button (digits as entered, position 0..4) for the bonded
 * phone apps (pin.entry, N28). Called from the main loop; sent from the session work queue. */
void pay_link_pin_progress(const char digits[5], int position);

int pay_link_pin_wanted(void);

/* The PIN the renter entered on the buttons (NU54_PIN_LEN digits, core/nu54_pin_entry.h), or
 * NULL when the entry timed out. */
void pay_link_pin(const char *pin, size_t len);

#endif /* PAY_LINK_H */
```

## src/status_led.c
```c
#include "status_led.h"

#include <zephyr/kernel.h>

#include "board_io.h"

/* A pattern is pairs of on and off times in milliseconds. */
typedef struct {
	const uint16_t *steps;
	uint8_t count; /* number of on/off pairs */
	bool repeat;
} pattern_t;

#define PATTERN(name, rep, ...)                                                                                        \
	static const uint16_t name##_steps[] = {__VA_ARGS__};                                                          \
	static const pattern_t name = {name##_steps, ARRAY_SIZE(name##_steps) / 2, rep}

PATTERN(P_MODE, true, 100, 1900);
PATTERN(P_PAIRING, true, 100, 150, 100, 1650);
PATTERN(P_BONDED, false, 1000, 0);
PATTERN(P_WAITING, true, 200, 200);
PATTERN(P_SIGNED, true, 500, 500);
PATTERN(P_APPROVED, false, 2000, 0);
PATTERN(P_FAILED, false, 100, 150, 100, 150, 100, 0);
PATTERN(P_PIN_START, false, 300, 200, 300, 0);
PATTERN(P_PIN_TAP, false, 80, 0);
PATTERN(P_PIN_KEEP, false, 500, 0);

#define SIGNED_MS 30000

static bool mode, pairing, waiting, signed_wait, pin_active;
static int64_t signed_until;
static const pattern_t *oneshot; /* plays over the ongoing pattern, then ends */
static const pattern_t *playing;
static uint8_t step; /* index of the half-step (on, off, on, off, ...) */

static void tick(struct k_work *w);
static K_WORK_DELAYABLE_DEFINE(tick_work, tick);
static struct k_spinlock lock; /* callers are the session work queue and the main loop */

static void lamp(bool on)
{
	for (uint8_t i = 0; i < BOARD_IO_COUNT; i++) {
		board_led_set(i, on);
	}
}

/* The ongoing indication, by priority; NULL is dark. */
static const pattern_t *ongoing(void)
{
	if (pin_active) {
		return NULL;
	}
	if (waiting) {
		return &P_WAITING;
	}
	if (signed_wait && k_uptime_get() < signed_until) {
		return &P_SIGNED;
	}
	signed_wait = false;
	if (pairing) {
		return &P_PAIRING;
	}
	return mode ? &P_MODE : NULL;
}

/* Starts the pattern that should show now, from its first step. */
static void restart(void)
{
	playing = oneshot ? oneshot : ongoing();
	step = 0;
	k_work_reschedule(&tick_work, K_NO_WAIT);
}

static void tick(struct k_work *w)
{
	(void)w;
	k_spinlock_key_t key = k_spin_lock(&lock);
	if (playing && step >= 2 * playing->count) {
		if (playing->repeat) {
			step = 0;
		} else {
			oneshot = NULL; /* a one-off ends: hand back to the ongoing pattern */
			playing = ongoing();
			step = 0;
		}
	}
	if (!playing) {
		lamp(false);
		k_spin_unlock(&lock, key);
		return;
	}
	bool on = (step % 2) == 0;
	uint16_t ms = playing->steps[step];
	step++;
	lamp(on && ms > 0);
	k_spin_unlock(&lock, key);
	k_work_reschedule(&tick_work, K_MSEC(ms > 0 ? ms : 1));
}

static void set(bool *flag, bool value)
{
	k_spinlock_key_t key = k_spin_lock(&lock);
	if (*flag != value) {
		*flag = value;
		if (!oneshot) {
			restart();
		}
	}
	k_spin_unlock(&lock, key);
}

static void play(const pattern_t *p)
{
	k_spinlock_key_t key = k_spin_lock(&lock);
	oneshot = p;
	restart();
	k_spin_unlock(&lock, key);
}

void status_led_mode(bool on)
{
	set(&mode, on);
}

void status_led_pairing(bool on)
{
	set(&pairing, on);
}

void status_led_paired(bool ok)
{
	play(ok ? &P_BONDED : &P_FAILED);
}

void status_led_waiting(bool on)
{
	set(&waiting, on);
}

void status_led_event(nu54_event_t event)
{
	if (event == NU54_EVENT_SIGNED) {
		k_spinlock_key_t key = k_spin_lock(&lock);
		signed_wait = true;
		signed_until = k_uptime_get() + SIGNED_MS;
		k_spin_unlock(&lock, key);
		set(&waiting, false);
		play(NULL); /* show the slow blinking now */
	} else if (event == NU54_EVENT_REFUSED) {
		k_spinlock_key_t key = k_spin_lock(&lock);
		signed_wait = false;
		k_spin_unlock(&lock, key);
		play(&P_FAILED);
	}
}

void status_led_outcome(bool approved)
{
	k_spinlock_key_t key = k_spin_lock(&lock);
	signed_wait = false;
	k_spin_unlock(&lock, key);
	play(approved ? &P_APPROVED : &P_FAILED);
}

void status_led_new_session(void)
{
	k_spinlock_key_t key = k_spin_lock(&lock);
	signed_wait = false;
	oneshot = NULL;
	restart();
	k_spin_unlock(&lock, key);
}

void status_led_clear(void)
{
	k_spinlock_key_t key = k_spin_lock(&lock);
	mode = pairing = waiting = signed_wait = pin_active = false;
	oneshot = NULL;
	restart();
	k_spin_unlock(&lock, key);
}

void status_led_idle(void)
{
	k_spinlock_key_t key = k_spin_lock(&lock);
	mode = waiting = signed_wait = false;
	if (!oneshot) {
		restart();
	}
	k_spin_unlock(&lock, key);
}

void status_led_pin(status_pin_t what)
{
	k_spinlock_key_t key = k_spin_lock(&lock);
	pin_active = true;
	k_spin_unlock(&lock, key);
	play(what == STATUS_PIN_START ? &P_PIN_START : what == STATUS_PIN_TAP ? &P_PIN_TAP : &P_PIN_KEEP);
}

void status_led_pin_end(void)
{
	set(&pin_active, false);
}
```
